/*
 * ntcCharacter.c
 *
 *  Created on: 2022年12月9日
 *      Author: Jeffery
 */
/*AAAAAAAAAAAAAAAAAAAAAAAAAAAAAAAAAAAAAAAAAAAAAAAAAAAAAAAAAA*/

#include "includeAll.h"
const uint32_t ntcAdcENV[] = {
     (uint32_t)	905385,      /*0    */     /*-30  */
     (uint32_t)	901512,      /*1    */     /*-29  */
     (uint32_t)	897493,      /*2    */     /*-28  */
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     (uint32_t)	45479 ,     /*159 */      /*129  */
     (uint32_t)	44512      /*160 */      /*130  */

};

int ad2temperature(uint32_t adv) {
	int i;
	for(i=0;i<160;i++)
	if(adv >= ntcAdcENV[i])break;
	return i-30;
}

int ad2temperature2(uint32_t adv) {
	int a = 0;
	int b = 160;
	int c = (a + b) / 2;

	if(adv <= ntcAdcENV[b]) {
		return b - 30;
	} else if(adv >= ntcAdcENV[a]) {
		return a - 30;
	}

	do {
		if(ntcAdcENV[c] > adv) {//要找的温度在下半部
			a = c;
			c = (a + b) / 2;
		} else {  //要找的温度在上半部
			b = c;
			c = (a + b) / 2;
		}
	}while(b - a > 1);  // 0 1

	//a指向大数 低温。b指向小数 高温
	if(1){
		uint32_t ave = (ntcAdcENV[a] + ntcAdcENV[b]) / 2;
		if(adv > ave) {
			return a - 30;
		} else {
			return b - 30;
		}
	}
}

/*****
 * 		adv:
 *			adcGet( ADC_CHANNEL_TEMP_ENV )
 *			adcGet(ADC_CHANNEL_TEMP_MOS)
 */
uint8_t isNtcFault(uint32_t adv) {
	if(adv > ADV_NTC_OPEN) {
		return 1;
	}
	if(adv < 44512) {
		return 1;
	}
//	if(ad2temperature(adv) > 118) {
//		return 1;
//	}
	return 0;
}
/*VVVVVVVVVVVVVVVVVVVVVVVVVVVVVVVVVVVVVVVVVVVVVVVVVVVVVVVVVV*/


